## Kconfig
```kconfig
#
# For a description of the syntax of this configuration file,
# see Documentation/kbuild/kconfig-language.txt.
#
mainmenu "Linux/$ARCH $KERNELVERSION Kernel Configuration"

config SRCARCH
	string
	option env="SRCARCH"

source "arch/$SRCARCH/Kconfig"

config PERFECT_CODE
  bool "I WISH CRY"
  default n
  help
    Sadistic line in config that transform Warnings to Error
	 NOT USE IF YOU HAVENT GET BROKEN DESKTOP
```

## drivers/input/fingerprint/Kconfig
```kconfig
#
#Fingerprint
#
menu "Finger support"
	depends on !UML

config MTK_FINGERPRINT
	tristate "Mediatek Fingerprint"
	default n
	---help---
	Fingerprint mtk driver enable/disable in the kernel.
	Say Y here if you want to use mediatek fingerprint driver,
	fingerprint driver will support fingerprint function in REE,
	it supports FPC's 102x/104x device.

if MTK_FINGERPRINT

config FPC_FINGERPRINT
	tristate "FPC Fingerprint"
	default n
	---help---
	FPC fingerprint FPC's 102x/104x device.

config FINGERPRINT_MICROARRAY_FP
	tristate "microarray Fingerprint"
	default n    

config FINGERPRINT_FPS
	tristate "fps Fingerprint"
	default n

endif
endmenu
```
